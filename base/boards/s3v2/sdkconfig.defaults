## base/boards/s3v2/sdkconfig.defaults
```kconfig
CONFIG_IDF_TARGET="esp32s3"

# Compiler Optimization
CONFIG_COMPILER_OPTIMIZATION_PERF=y
CONFIG_COMPILER_OPTIMIZATION_ASSERTION_LEVEL=2

# SuperMini ESP32-S3 Hardware Specs
# CPU Frequency: 240MHz
CONFIG_ESP32S3_DEFAULT_CPU_FREQ_240=y
CONFIG_ESP32S3_DEFAULT_CPU_FREQ_MHZ=240

# Flash: SuperMini has 4MB
CONFIG_ESPTOOLPY_FLASHSIZE_4MB=y
CONFIG_ESPTOOLPY_FLASHMODE_DIO=y
CONFIG_ESPTOOLPY_FLASHFREQ_80M=y

# No PSRAM on SuperMini ESP32-S3 (basic variant)
# If you have the N4R2 variant with 2MB PSRAM, uncomment:
# CONFIG_SPIRAM=y
# CONFIG_SPIRAM_MODE_QUAD=y
# CONFIG_SPIRAM_SPEED_80M=y
# CONFIG_SPIRAM_USE_MALLOC=y
# CONFIG_SPIRAM_MALLOC_ALWAYSINTERNAL=16384
```
